## configs/qrk3588_defconfig
```kconfig
BR2_aarch64=y
BR2_cortex_a76_a55=y
BR2_TARGET_GENERIC_HOSTNAME="quest"
BR2_TARGET_GENERIC_ISSUE="Welcome to QuestOS"
BR2_TARGET_ROOTFS_EXT2=y
BR2_TARGET_ROOTFS_EXT2_4=y
BR2_TARGET_ROOTFS_EXT2_SIZE="128M"
BR2_TARGET_ROOTFS_TAR=y
BR2_TOOLCHAIN_EXTERNAL=y
BR2_TOOLCHAIN_EXTERNAL_CUSTOM=y
BR2_TOOLCHAIN_EXTERNAL_PREINSTALLED=y
BR2_TOOLCHAIN_EXTERNAL_PATH="$(TOPDIR)/../toolchain/gcc"
BR2_TOOLCHAIN_EXTERNAL_CUSTOM_PREFIX="aarch64-linux-gnu"
BR2_TOOLCHAIN_EXTERNAL_GCC_15=y
BR2_TOOLCHAIN_EXTERNAL_HEADERS_7_2=y
BR2_TOOLCHAIN_EXTERNAL_CUSTOM_GLIBC=y
# BR2_TOOLCHAIN_EXTERNAL_INET_RPC is not set
```

## configs/qrk3588_toolchain_defconfig
```kconfig
# SPDX-License-Identifier: GPL-2.0-or-later
BR2_aarch64=y
BR2_cortex_a76_a55=y
BR2_TOOLCHAIN_BUILDROOT_GLIBC=y
BR2_KERNEL_HEADERS_7_2=y
BR2_GCC_VERSION_15_X=y
BR2_PACKAGE_HOST_GDB=y
BR2_PACKAGE_HOST_GDB_PYTHON3=y
BR2_GDB_VERSION_16=y
# BR2_TARGET_ROOTFS_TAR is not set
```
